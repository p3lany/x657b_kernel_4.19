## drivers/input/touchscreen/nt36572_common/Kconfig
```kconfig
#
# Novatek NT36xxx touchscreen driver configuration
#
menu "NT36xxx support"
	depends on INPUT_TOUCHSCREEN

config TOUCHSCREEN_MTK_NT36572_COMMON
	bool "Novatek NT36xxx"
	help
	  Say Y here if you have a Novatek NT36xxx touchscreen connected
	  to your system.

	  If unsure, say N.

endmenu
```
